## boards/shields/aerogu34/Kconfig.defconfig
```kconfig
if SHIELD_AEROGU34_LEFT || SHIELD_AEROGU34_RIGHT

config ZMK_SPLIT
    default y

config NFCT_PINS_AS_GPIOS
    default y

endif

if SHIELD_AEROGU34_RIGHT

config ZMK_KEYBOARD_NAME
    default "Aerogu34"

config ZMK_SPLIT_ROLE_CENTRAL
    default y

endif
```

## boards/shields/aerogu34/Kconfig.shield
```kconfig
config SHIELD_AEROGU34_LEFT
    def_bool $(shields_list_contains,aerogu34_left)

config SHIELD_AEROGU34_RIGHT
    def_bool $(shields_list_contains,aerogu34_right)
```

## config/west.yml
```yaml
manifest:
  defaults:
    revision: main
  remotes:
    - name: cormoran
      url-base: https://github.com/cormoran
    - name: sekigon-gonnoc
      url-base: https://github.com/sekigon-gonnoc
    - name: caksoylar
      url-base: https://github.com/caksoylar
    - name: prospector
      url-base: https://github.com/t-ogura
  projects:
    # ZMK: cormoran fork with DYA Studio RPC subsystem
    - name: zmk
      remote: cormoran
      revision: v0.3-branch+dya
      import: app/west.yml
    # Trackball driver
    - name: zmk-driver-paw3222
      remote: sekigon-gonnoc
    # RGB LED widget
    # Pin to commit before "Remove v0.3 compatibility shims" (5b5a198);
    # later commits drop seeeduino_xiao_ble.overlay (and v0.3 compat shims).
    - name: zmk-rgbled-widget
      remote: caksoylar
      revision: a3510c9de46de8b42c803286f4978466c6ea3916
    # DYA Studio modules
    # cormoran's modules are migrating their main branches to ZMK main /
    # Zephyr 4.x, but we're on ZMK v0.3-branch+dya / Zephyr 3.5. Two of the
    # four have a 'zmk-v0.3.0.0' tag pointing at the last v0.3-compatible
    # commit; use it. The other two still have v0.3-compatible mains but no
    # tag, so pin defensively to the current tip SHA (so a future v4 PR
    # doesn't silently break this build).
    - name: zmk-module-ble-management
      remote: cormoran
      revision: zmk-v0.3.0.0
    - name: zmk-module-battery-history
      remote: cormoran
      revision: 307755dd2ad4d320e14de162e8e5ef018f29d929
    - name: zmk-module-settings-rpc
      remote: cormoran
      revision: ad1c995cf910ca989ecd6352a1d0b41ccb18362c
    - name: zmk-module-runtime-input-processor
      remote: cormoran
      revision: zmk-v0.3.0.0
    # Deadzone input processor
    - name: zmk-input-processor-deadzone
      remote: prospector
    # Prospector
    - name: prospector-zmk-module
      remote: prospector
      revision: main
      path: modules/prospector-zmk-module
  self:
    path: config
```
